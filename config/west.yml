## config/west.yml
```yaml
manifest:
  remotes:
    - name: zmkfirmware
      url-base: https://github.com/zmkfirmware
    - name: badjeff
      url-base: https://github.com/badjeff
    - name: carrefinho
      url-base: https://github.com/carrefinho
    - name: mike1808
      url-base: https://github.com/mike1808
    - name: janpfischer
      url-base: https://github.com/janpfischer
    - name: joelspadin
      url-base: https://github.com/joelspadin
    - name: urob
      url-base: https://github.com/urob
  projects:
    - name: zmk
      remote: zmkfirmware
      revision: 9490391e1e4010c83291d437b7f9a71ace244581
      import: app/west.yml
    # - name: zmk-dongle-screen
    #   remote: janpfischer
    #   revision: upgrade-4.1
    - name: prospector-zmk-module
      remote: mike1808
      revision: f117cd8d65da2c6c46f80d5293aac78362ae35a8
    - name: zmk-locales
      remote: joelspadin
      revision: be0427eaa80c7bb9a3d74ab11a78d53b98f5c5aa
    - name: zmk-unicode
      remote: urob
      revision: v0.3
  self:
    path: config
```
